VERSION "1.0"

NS_ :

BS_:

BU_: VCU BMS HMI

BO_ 256 VCU_STATE: 64 VCU
 SG_ VehicleSpeed : 0|16@1+ (0.01,0) [0|655.35] "km/h" Vector__XXX
 SG_ MotorRPM : 16|16@1+ (1,0) [0|65535] "rpm" Vector__XXX
 SG_ ThrottlePct : 32|16@1+ (0.01,0) [0|100] "%" Vector__XXX
 SG_ BrakePressure : 48|16@1+ (0.1,0) [0|6553.5] "bar" Vector__XXX
 SG_ BatteryVoltage : 64|16@1+ (0.01,0) [0|655.35] "V" Vector__XXX
 SG_ BatteryCurrent : 80|16@1- (0.01,0) [-327.68|327.67] "A" Vector__XXX
 SG_ DriveMode : 96|8@1+ (1,0) [0|255] "" Vector__XXX
 SG_ Gear : 104|8@1+ (1,0) [0|255] "" Vector__XXX
 SG_ SteeringAngle : 112|16@1- (0.1,0) [-3276.8|3276.7] "deg" Vector__XXX
 SG_ YawRate : 128|16@1- (0.01,0) [-327.68|327.67] "deg/s" Vector__XXX
 SG_ LateralAccel : 144|16@1- (0.01,0) [-327.68|327.67] "m/s^2" Vector__XXX
 SG_ LongitudinalAccel : 160|16@1- (0.01,0) [-327.68|327.67] "m/s^2" Vector__XXX
 SG_ WheelSpeedFL : 176|16@1+ (0.01,0) [0|655.35] "km/h" Vector__XXX
 SG_ WheelSpeedFR : 192|16@1+ (0.01,0) [0|655.35] "km/h" Vector__XXX
 SG_ WheelSpeedRL : 208|16@1+ (0.01,0) [0|655.35] "km/h" Vector__XXX
 SG_ WheelSpeedRR : 224|16@1+ (0.01,0) [0|655.35] "km/h" Vector__XXX
 SG_ Odometer : 240|32@1+ (0.001,0) [0|4294967.295] "km" Vector__XXX
 SG_ CabinTemp : 272|16@1- (0.1,0) [-3276.8|3276.7] "degC" Vector__XXX
 SG_ AmbientTemp : 288|16@1- (0.1,0) [-3276.8|3276.7] "degC" Vector__XXX
 SG_ HVACFanSpeed : 304|8@1+ (1,0) [0|255] "" Vector__XXX
 SG_ ACSetpoint : 312|8@1+ (0.5,0) [0|127.5] "degC" Vector__XXX
 SG_ DoorStatus : 320|8@1+ (1,0) [0|255] "" Vector__XXX
 SG_ WindowFL : 328|8@1+ (0.5,0) [0|127.5] "%" Vector__XXX
 SG_ WindowFR : 336|8@1+ (0.5,0) [0|127.5] "%" Vector__XXX
 SG_ WindowRL : 344|8@1+ (0.5,0) [0|127.5] "%" Vector__XXX
 SG_ WindowRR : 352|8@1+ (0.5,0) [0|127.5] "%" Vector__XXX
 SG_ LightStatus : 360|8@1+ (1,0) [0|255] "" Vector__XXX
 SG_ WiperStatus : 368|8@1+ (1,0) [0|255] "" Vector__XXX
 SG_ TirePressureFL : 376|8@1+ (0.1,0) [0|25.5] "bar" Vector__XXX
 SG_ TirePressureFR : 384|8@1+ (0.1,0) [0|25.5] "bar" Vector__XXX
 SG_ TirePressureRL : 392|8@1+ (0.1,0) [0|25.5] "bar" Vector__XXX
 SG_ TirePressureRR : 400|8@1+ (0.1,0) [0|25.5] "bar" Vector__XXX
 SG_ BatterySOC : 408|16@1+ (0.01,0) [0|100] "%" Vector__XXX
 SG_ BatteryTemp : 424|16@1- (0.1,0) [-3276.8|3276.7] "degC" Vector__XXX
 SG_ PackVoltage : 440|16@1+ (0.01,0) [0|655.35] "V" Vector__XXX
 SG_ PackCurrent : 456|16@1- (0.01,0) [-327.68|327.67] "A" Vector__XXX
 SG_ CellVoltMax : 472|16@1+ (0.01,0) [0|655.35] "V" Vector__XXX
 SG_ CellVoltMin : 488|16@1+ (0.01,0) [0|655.35] "V" Vector__XXX
 SG_ CellTempMax : 504|8@1- (1,0) [-128|127] "degC" Vector__XXX
 SG_ CellTempMin : 506|2@1- (1,0) [-2|1] "degC" Vector__XXX
 SG_ CellTempAvg : 505|3@1- (1,0) [-4|3] "degC" Vector__XXX
 SG_ SpareB63 : 508|4@1+ (1,0) [0|15] "" Vector__XXX

BO_ 512 BMS_PACK: 32 BMS
 SG_ PackSOC : 0|16@1+ (0.01,0) [0|100] "%" Vector__XXX
 SG_ PackSOH : 16|16@1+ (0.01,0) [0|100] "%" Vector__XXX
 SG_ PackVoltage : 32|16@1+ (0.01,0) [0|655.35] "V" Vector__XXX
 SG_ PackCurrent : 48|16@1- (0.01,0) [-327.68|327.67] "A" Vector__XXX
 SG_ CellVoltMax : 64|16@1+ (0.01,0) [0|655.35] "V" Vector__XXX
 SG_ CellVoltMin : 80|16@1+ (0.01,0) [0|655.35] "V" Vector__XXX
 SG_ CellVoltDelta : 96|16@1+ (0.01,0) [0|655.35] "V" Vector__XXX
 SG_ CellTempMax : 112|8@1- (1,0) [-128|127] "degC" Vector__XXX
 SG_ CellTempMin : 120|8@1- (1,0) [-128|127] "degC" Vector__XXX
 SG_ PackCycles : 128|16@1+ (1,0) [0|65535] "" Vector__XXX
 SG_ PackTempAvg : 144|16@1- (0.1,0) [-3276.8|3276.7] "degC" Vector__XXX
 SG_ InsulationRes : 160|16@1+ (1,0) [0|65535] "kOhm" Vector__XXX
 SG_ ChargeState : 176|8@1+ (1,0) [0|255] "" Vector__XXX
 SG_ ChargePower : 184|16@1+ (0.1,0) [0|6553.5] "kW" Vector__XXX
 SG_ BatteryHeaterOn : 200|1@1+ (1,0) [0|1] "" Vector__XXX
 SG_ CoolantPumpOn : 201|1@1+ (1,0) [0|1] "" Vector__XXX
 SG_ BalancerActive : 202|1@1+ (1,0) [0|1] "" Vector__XXX
 SG_ ChargerConnected : 203|1@1+ (1,0) [0|1] "" Vector__XXX
 SG_ ChargerType : 204|4@1+ (1,0) [0|15] "" Vector__XXX
 SG_ EstimatedChargeTime : 208|16@1+ (1,0) [0|65535] "min" Vector__XXX
 SG_ EnergyDelivered : 224|32@1+ (0.001,0) [0|4294967.295] "kWh" Vector__XXX
 SG_ EnergyReceived : 256|32@1+ (0.001,0) [0|4294967.295] "kWh" Vector__XXX

CM_ "Generated for CAN FD 64-byte layout testing";
CM_ BO_ 256 "VCU periodic state broadcast (CAN FD 64-byte)";
CM_ BO_ 512 "BMS pack telemetry (CAN FD 32-byte)";
CM_ SG_ 256 VehicleSpeed "Filtered vehicle speed from ESP";
